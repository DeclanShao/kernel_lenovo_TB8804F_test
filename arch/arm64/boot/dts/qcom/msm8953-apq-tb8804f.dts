/*
 * Copyright (c) 2015-2017, The Linux Foundation. All rights reserved.
 *
 * This program is free software; you can redistribute it and/or modify
 * it under the terms of the GNU General Public License version 2 and
 * only version 2 as published by the Free Software Foundation.
 *
 * This program is distributed in the hope that it will be useful,
 * but WITHOUT ANY WARRANTY; without even the implied warranty of
 * MERCHANTABILITY or FITNESS FOR A PARTICULAR PURPOSE.  See the
 * GNU General Public License for more details.
 */

/dts-v1/;

#include "apq8053.dtsi"
#include "pmi8950.dtsi"
#include "msm8953-mtp.dtsi"
#include "msm8953-pmi8950.dtsi"
#include "msm8953-camera-sensor-mtp.dtsi"

/ {
	model = "Qualcomm Technologies, Inc. APQ8053 MTP";
	compatible = "qcom,apq8053-mtp", "qcom,apq8053", "qcom,mtp";
	qcom,board-id= <8 0>;
        qcom,msm-id = <0x130 0x00>;
};

/{
        mtp_batterydata: qcom,battery-data {
                qcom,batt-id-range-pct = <15>;
                #include "tb8804f/batterydata-scud-4850mah.dtsi"
                #include "tb8804f/batterydata-sunwoda-4850mah.dtsi"
        };
};

&qpnp_fg {
        qcom,battery-data = <&mtp_batterydata>;
};

&qpnp_smbcharger {
        qcom,battery-data = <&mtp_batterydata>;
        qcom,chg-led-sw-controls;
        qcom,chg-led-support;
        qcom,external-typec;
        qcom,typec-psy-name = "typec";
};

#include "tb8804f/tb8804f-overlay.dtsi"